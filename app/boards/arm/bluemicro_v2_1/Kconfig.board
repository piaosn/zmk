## app/boards/arm/bluemicro_v2_1/Kconfig.board
```kconfig
# BlueMicro840 board configuration

# Copyright (c) 2020 Pete Johanson, Derek Schmell
# SPDX-License-Identifier: MIT

config BOARD_BLUEMICRO_V2_1
	bool "BlueMicro_V2_1"
	depends on SOC_NRF52832_QFAA
```

## app/boards/arm/bluemicro_v2_1/Kconfig.defconfig
```kconfig
# BlueMicro840 board configuration

# Copyright (c) 2020 Pete Johanson, Derek Schmell
# SPDX-License-Identifier: MIT

if BOARD_BLUEMICRO_V2_1

config BOARD
	default "bluemicro_v2_1"

config BT_CTLR
	default BT

config ZMK_BLE
	default y

config ZMK_BATTERY_VOLTAGE_DIVIDER
	default y

endif # BOARD_BLUEMICRO_V2_1
```

## app/boards/arm/nrf_hhkb/Kconfig.board
```kconfig
# nrf_hhkb board configuration

# Copyright (c) 2022 The ZMK Contributors
# SPDX-License-Identifier: MIT

config BOARD_NRF_HHKB
	bool "nrf_hhkb"
	depends on SOC_NRF52840_QIAA
```

## app/boards/arm/nrf_hhkb/nrf_hhkb_defconfig
```kconfig
# SPDX-License-Identifier: MIT

CONFIG_SOC_SERIES_NRF52X=y
CONFIG_SOC_NRF52840_QIAA=y
CONFIG_BOARD_NRF_HHKB=y

# Enable MPU
CONFIG_ARM_MPU=y

# enable GPIO
CONFIG_GPIO=y

# enable Kscan HHKB Driver 
CONFIG_ZMK_KSCAN_GPIO_DRIVER=n
CONFIG_ZMK_KSCAN_HHKB_DRIVER=y

# Core
CONFIG_USE_DT_CODE_PARTITION=y
CONFIG_MPU_ALLOW_FLASH_WRITE=y
CONFIG_NVS=y
CONFIG_SETTINGS_NVS=y
CONFIG_FLASH=y
CONFIG_FLASH_PAGE_LAYOUT=y
CONFIG_FLASH_MAP=y
CONFIG_CLOCK_CONTROL_NRF=y
CONFIG_CLOCK_CONTROL_NRF_K32SRC_RC=y

# CONFIG_NRFX_SPIM=y
CONFIG_NRFX_SPIM0=y
CONFIG_ZMK_DISPLAY=y
CONFIG_ZMK_WIDGET_WPM_STATUS=n

# Power Management
CONFIG_ZMK_SLEEP=n
# CONFIG_ZMK_IDLE_SLEEP_TIMEOUT=60000
# CONFIG_ADC=y
# CONFIG_ADC_NRFX_SAADC=y

# RGB
# CONFIG_ZMK_BACKLIGHT_AUTO_OFF_IDLE=y
# CONFIG_ZMK_BACKLIGHT_AUTO_OFF_USB=y

# DEBUG
CONFIG_ZMK_USB_LOGGING=y
```

## app/boards/arm/nrfmicro_14/Kconfig.board
```kconfig
# nrfmicro board configuration

# Copyright (c) 2020 The ZMK Contributors
# SPDX-License-Identifier: MIT

config BOARD_NRFMICRO_14
	bool "nrfmicro_14"
	depends on SOC_NRF52840_QIAA
```

## app/boards/shields/psn_digipad/Kconfig.shield
```kconfig
# Copyright (c) 2020 Pete Johanson
# SPDX-License-Identifier: MIT

config SHIELD_PSN_DIGIPAD
	def_bool $(shields_list_contains,psn_digipad)
```

## app/dts/bindings/zmk,kscan-hhkb.yaml
```yaml
# Copyright (c) 2022, Paul Park
# SPDX-License-Identifier: MIT

description: HHKB keyboard matrix controller

compatible: "zmk,kscan-hhkb"

include: kscan.yaml

properties:
  row0-gpios:
    type: phandle-array
    required: true
  row1-gpios:
    type: phandle-array
    required: true
  row2-gpios:
    type: phandle-array
    required: true
  col0-gpios:
    type: phandle-array
    required: true
  col1-gpios:
    type: phandle-array
    required: true
  col2-gpios:
    type: phandle-array
    required: true
  col-en-gpios:
    type: phandle-array
    required: true
  hys-gpios:
    type: phandle-array
    required: true
  key-gpios:
    type: phandle-array
    required: true
  row-en0-gpios:
    type: phandle-array
    required: true
  row-en1-gpios:
    type: phandle-array
    required: true
  poll-period-ms:
    type: int
    default: 10
    description: Time between reads in milliseconds when no key is pressed and ZMK_KSCAN_MATRIX_POLLING is enabled.
```
